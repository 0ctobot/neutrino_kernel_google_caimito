## caimito_defconfig
```kconfig
CONFIG_IOVAD_BEST_FIT_ALGO=m
CONFIG_GS_PANEL_SIMPLE=m
CONFIG_DSIM_LOGBUFF=y
CONFIG_DEBUG_PANEL_TEST=y
CONFIG_REGULATOR_RT6160_GS=m
CONFIG_CP_PMIC=m
CONFIG_QCOM_QBT_HANDLER=m
CONFIG_PROACTIVE_KILL=m
```

## comet_defconfig
```kconfig
CONFIG_IOVAD_BEST_FIT_ALGO=m
CONFIG_DSIM_LOGBUFF=y
CONFIG_REGULATOR_RT6160_GS=m
CONFIG_CP_PMIC=m
CONFIG_LINK_DEVICE_PCIE_IOMMU=y
CONFIG_PROACTIVE_KILL=m
CONFIG_RADIO_S5400=y
```

## google-modules/Kconfig
```kconfig
# SPDX-License-Identifier: GPL-2.0

config GOOGLE_MODULES
	def_bool y
	select DRM_MIPI_DSI
	select GPIOLIB_IRQCHIP
	select REGMAP_IRQ
	select SND_SOC_COMPRESS
	select VIDEOMODE_HELPERS

config CAIMITO
	bool "Build caimito kernel"
	default y

config SHUSKY
	bool "Build shusky kernel"
	depends on !CAIMITO
	default n
```
