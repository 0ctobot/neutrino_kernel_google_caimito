// SPDX-License-Identifier: GPL-2.0-only
/*
 * Comet board device tree source
 *
 * Copyright 2024 Google LLC
 */
&google_battery {
	google,chg-battery-capacity = <4560>;
	google,batt-id-1-atl {
		google,batt-id = <1>;
		google,aacr-ref-cycles = <200 300 400 500 600 700 800>;
		google,aacr-ref-fade10 = < 15  24  32  40  49  58  66>;
		google,aafv-ref-cycles = <
			200  250  300  350  400  450  500  550
			600  650  700  750  800  850  900  950
		>;
		google,aafv-ref-offset = <
			  0  10  10  20  20  30  30  40
			 40  50  50  60  60  70  80  90
		>;
	};
	google,batt-id-2-cos {
		google,batt-id = <2>;
		google,aacr-ref-cycles = <200 300 400 500 600 700 800>;
		google,aacr-ref-fade10 = < 15  24  32  40  49  58  66>;
		google,aafv-ref-cycles = <
			200  250  300  350  400  450  500  550
			600  650  700  750  800  850  900  950
		>;
		google,aafv-ref-offset = <
			  0  10  10  20  20  30  30  40
			 40  50  50  60  60  70  80  90
		>;
	};
};
